## config/west.yml
```yaml
manifest:
  remotes:
    - name: zmkfirmware 
      url-base: https://github.com/zmkfirmware
    - name: MeowCatpawkittie
      url-base: https://github.com/MeowCatpawkittie
    - name: caksoylar
      url-base: https://github.com/caksoylar  
    - name: badjeff
      url-base: https://github.com/badjeff
  projects:
    - name: zmk
      remote: zmkfirmware
      revision: cb615aee9a7c427e251f2ab62080c1a44a165da9
      import: app/west.yml
    - name: zmk-pmw3610-driver
      remote: badjeff
      revision: 44b4a76b74d293a93cec4ccb7e04cb8d29c10f93
    - name: zmk-rgbled-widget
      remote: caksoylar
      revision: main
  self:
    path: config
```
